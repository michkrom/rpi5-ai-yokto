## layers/meta-doom/conf/layer.conf
```bitbake
BBPATH .= ":${LAYERDIR}"
BBFILES += "${LAYERDIR}/recipes-*/*/*.bb ${LAYERDIR}/recipes-*/*/*.bbappend"

BBFILE_COLLECTIONS += "doom"
BBFILE_PATTERN_doom = "^${LAYERDIR}/"
BBFILE_PRIORITY_doom = "10"
LAYERSERIES_COMPAT_doom = "scarthgap"
```

## layers/meta-games/conf/layer.conf
```bitbake
BBPATH .= ":${LAYERDIR}"
BBFILES += "${LAYERDIR}/recipes-*/*/*.bb ${LAYERDIR}/recipes-*/*/*.bbappend"

BBFILE_COLLECTIONS += "games"
BBFILE_PATTERN_games = "^${LAYERDIR}/"
BBFILE_PRIORITY_games = "10"
LAYERSERIES_COMPAT_games = "scarthgap"
```

## layers/meta-quake3/conf/layer.conf
```bitbake
BBPATH .= ":${LAYERDIR}"
BBFILES += "${LAYERDIR}/recipes-*/*/*.bb ${LAYERDIR}/recipes-*/*/*.bbappend"

BBFILE_COLLECTIONS += "quake3"
BBFILE_PATTERN_quake3 = "^${LAYERDIR}/"
BBFILE_PRIORITY_quake3 = "10"
LAYERSERIES_COMPAT_quake3 = "scarthgap"
```

## layers/meta-yokto/conf/layer.conf
```bitbake
BBPATH .= ":${LAYERDIR}"
BBFILES += "${LAYERDIR}/recipes-*/*/*.bb ${LAYERDIR}/recipes-*/*/*.bbappend"

BBFILE_COLLECTIONS += "yokto"
BBFILE_PATTERN_yokto = "^${LAYERDIR}/"
BBFILE_PRIORITY_yokto = "12"
LAYERSERIES_COMPAT_yokto = "scarthgap"
```
